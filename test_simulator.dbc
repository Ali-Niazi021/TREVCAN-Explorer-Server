VERSION ""

NS_ :

BS_:

BU_: TEST_ECU

BO_ 192 TEST_EngineRPM: 8 TEST_ECU
 SG_ RPM : 7|16@0+ (1,0) [0|8000] "rpm" Vector__XXX

BO_ 176 TEST_VehicleSpeed: 8 TEST_ECU
 SG_ Speed : 7|16@0+ (0.1,0) [0|300] "km/h" Vector__XXX

BO_ 208 TEST_ThrottlePosition: 8 TEST_ECU
 SG_ Throttle : 0|8@1+ (0.392156862745098,0) [0|100] "%" Vector__XXX

BO_ 224 TEST_CoolantTemp: 8 TEST_ECU
 SG_ Temperature : 0|8@1+ (1,-40) [-40|215] "C" Vector__XXX

BO_ 416 TEST_BrakePressure: 8 TEST_ECU
 SG_ Brake : 0|8@1+ (0.392156862745098,0) [0|100] "%" Vector__XXX

BO_ 432 TEST_SteeringAngle: 8 TEST_ECU
 SG_ Angle : 7|16@0+ (0.1,-180) [-180|180] "deg" Vector__XXX

BO_ 448 TEST_BatteryVoltage: 8 TEST_ECU
 SG_ Voltage : 0|8@1+ (0.1,0) [0|25.5] "V" Vector__XXX

BO_ 464 TEST_FuelLevel: 8 TEST_ECU
 SG_ Fuel : 0|8@1+ (0.392156862745098,0) [0|100] "%" Vector__XXX
